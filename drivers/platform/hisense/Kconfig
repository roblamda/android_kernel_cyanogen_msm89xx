## drivers/platform/hisense/Kconfig
```kconfig
# Hisense configuration options

config MACH_HISENSE
	bool "Hisense device"
	depends on ARCH_MSM
	help
	  Support for Hisense products

config MACH_HISENSE_MSM8916
	bool "Hisense MSM8916"
	depends on ARCH_MSM8916
	select MACH_HISENSE
	help
	  Support for MSM8916 Hisense variants

menu "Hisense board selection"

config MACH_SOTO
	bool "Soto board"
	select MACH_HISENSE_MSM8916
	help
	  Support for Hisense Soto (LC642U) variant

endmenu
```

## drivers/platform/zte/Kconfig
```kconfig
# ZTE configuration options

config MACH_HAIER
	bool "Haier device"
	depends on ARCH_MSM
	help
	  Support for ZTE products

config MACH_HAIER_MSM8909
	bool "Haier MSM8909"
	depends on ARCH_MSM8909
	select MACH_HAIER
	help
	  Support for MSM8909 ZTE variants

config MACH_HAIER_MSM8916
	bool "Haier MSM8916"
	depends on ARCH_MSM8916
	select MACH_HAIER
	help
	  Support for MSM8916 ZTE variants

menu "ZTE board selection"

config MACH_G151
	bool "G151 board"
	select MACH_HAIER_MSM8909
	help
	  Support for ZTE G151 variant

config MACH_RENDANG
	bool "Rendang board"
	select MACH_HAIER_MSM8916
	help
	  Support for ZTE Rendang variant

endmenu
```
